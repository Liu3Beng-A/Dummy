#include <stddef.h>
#include <string.h>
#include <time.h>

#if defined(__cplusplus)
extern "C" {
#endif
const char *mg_unlist(size_t no);
const char *mg_unpack(const char *, size_t *, time_t *);
#if defined(__cplusplus)
}
#endif

static const unsigned char v1[] = {
  31, 139,   8,   8, 237,  72,  68, 101,   0,   3, 109,  97, // .....HDe..ma
 105, 110,  46, 106, 115,   0, 181,  26, 107, 115, 218,  58, // in.js...ks.:
 246, 123, 126, 133, 150, 102, 107, 179, 117, 204, 155, 116, // .{~..fk.u..t
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 198, 209, 138,  39,   0,   0, 0 // ...'..
};
static const unsigned char v2[] = {
  31, 139,   8,   8, 237,  72,  68, 101,   0,   3, 112, 114, // .....HDe..pr
 101,  97,  99, 116,  46, 109, 105, 110,  46, 106, 115,   0, // eact.min.js.
 157,  91, 123, 119, 219, 182, 146, 255, 127,  63,  69, 164, // .[{w.....?E.
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 138,  51,   0,   0, 0 // .3..
};
static const unsigned char v3[] = {
  31, 139,   8,   8, 237,  72,  68, 101,   0,   3, 105, 110, // .....HDe..in
 100, 101, 120,  46, 104, 116, 109, 108,   0,  93, 144, 177, // dex.html.]..
  78, 196,  48,  12, 134, 247, 123, 138, 144, 153, 180, 176, // N.0...{.....
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 130, 117,   1,   0,   0, 0 // .u...
};
static const unsigned char v4[] = {
  31, 139,   8,   8, 237,  72,  68, 101,   0,   3, 115, 116, // .....HDe..st
 121, 108, 101,  46,  99, 115, 115,   0, 181,  86, 193, 142, // yle.css..V..
 219,  54,  16, 189, 251,  43,  88,   4,   5, 218, 197, 202, // .6...+X.....
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 129, 131, 223,   1,  35, 101, 148, 138,  25,  10,   0,   0, 0 // ....#e......
};

static const struct packed_file {
  const char *name;
  const unsigned char *data;
  size_t size;
  time_t mtime;
} packed_files[] = {
  {"/web_root/main.js.gz", v1, sizeof(v1), 1698973933},
  {"/web_root/preact.min.js.gz", v2, sizeof(v2), 1698973933},
  {"/web_root/index.html.gz", v3, sizeof(v3), 1698973933},
  {"/web_root/style.css.gz", v4, sizeof(v4), 1698973933},
  {NULL, NULL, 0, 0}
};

static int scmp(const char *a, const char *b) {
  while (*a && (*a == *b)) a++, b++;
  return *(const unsigned char *) a - *(const unsigned char *) b;
}
const char *mg_unlist(size_t no) {
  return packed_files[no].name;
}
const char *mg_unpack(const char *name, size_t *size, time_t *mtime) {
  const struct packed_file *p;
  for (p = packed_files; p->name != NULL; p++) {
    if (scmp(p->name, name) != 0) continue;
    if (size != NULL) *size = p->size - 1;
    if (mtime != NULL) *mtime = p->mtime;
    return (const char *) p->data;
  }
  return NULL;
}
